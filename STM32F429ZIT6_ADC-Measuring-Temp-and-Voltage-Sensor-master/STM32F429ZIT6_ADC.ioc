# file: STM32F429ZIT6_ADC.ioc
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Mcu.Family=STM32F4
Mcu.Name=STM32F429ZITx
Mcu.Package=LQFP144
NVIC.PriorityGroup=NVIC_PRIORITYGROUP_4
PA13.Mode=Serial_Wire
PA13.Signal=SYS_JTMS-SWDIO
PA14.Mode=Serial_Wire
PA14.Signal=SYS_JTCK-SWCLK
PH0/OSC_IN.Mode=HSE-External-Oscillator
PH0/OSC_IN.Signal=RCC_OSC_IN
PH1/OSC_OUT.Mode=HSE-External-Oscillator
PH1/OSC_OUT.Signal=RCC_OSC_OUT
ProjectManager.HeapSize=0x200
ProjectManager.StackSize=0x400
ProjectManager.TargetToolchain=SW4STM32
RCC.48MHZClocksFreq_Value=90000000
RCC.AHBFreq_Value=180000000
RCC.APB1CLKDivider=RCC_HCLK_DIV4
RCC.APB1Freq_Value=45000000
RCC.APB1TimFreq_Value=90000000
RCC.APB2CLKDivider=RCC_HCLK_DIV2
RCC.APB2Freq_Value=90000000
RCC.APB2TimFreq_Value=180000000
RCC.CortexFreq_Value=180000000
RCC.HCLKFreq_Value=180000000
RCC.HSE_VALUE=8000000
RCC.HSI_VALUE=16000000
RCC.LSE_VALUE=32768
RCC.PLLM=4
RCC.PLLN=180
RCC.PLLSourceVirtual=RCC_PLLSOURCE_HSE
RCC.SYSCLKFreq_VALUE=180000000
RCC.SYSCLKSource=RCC_SYSCLKSOURCE_PLLCLK
RCC.VCOOutputFreq_Value=360000000
board=custom

// file: Src/main.c
/* USER CODE BEGIN Header */
/**
  ******************************************************************************
  * @file           : main.c
  * @brief          : Main program body
  ******************************************************************************
  ** This notice applies to any and all portions of this file
  * that are not between comment pairs USER CODE BEGIN and
  * USER CODE END. Other portions of this file, whether
  * inserted by the user or by software development tools
  * are owned by their respective copyright owners.
  *
  * COPYRIGHT(c) 2019 STMicroelectronics
  *
  * Redistribution and use in source and binary forms, with or without modification,
  * are permitted provided that the following conditions are met:
  *   1. Redistributions of source code must retain the above copyright notice,
  *      this list of conditions and the following disclaimer.
  *   2. Redistributions in binary form must reproduce the above copyright notice,
  *      this list of conditions and the following disclaimer in the documentation
  *      and/or other materials provided with the distribution.
  *   3. Neither the name of STMicroelectronics nor the names of its contributors
  *      may be used to endorse or promote products derived from this software
  *      without specific prior written permission.
  *
  * THIS SOFTWARE IS PROVIDED BY THE COPYRIGHT HOLDERS AND CONTRIBUTORS "AS IS"
  * AND ANY EXPRESS OR IMPLIED WARRANTIES, INCLUDING, BUT NOT LIMITED TO, THE
  * IMPLIED WARRANTIES OF MERCHANTABILITY AND FITNESS FOR A PARTICULAR PURPOSE ARE
  * DISCLAIMED. IN NO EVENT SHALL THE COPYRIGHT HOLDER OR CONTRIBUTORS BE LIABLE
  * FOR ANY DIRECT, INDIRECT, INCIDENTAL, SPECIAL, EXEMPLARY, OR CONSEQUENTIAL
  * DAMAGES (INCLUDING, BUT NOT LIMITED TO, PROCUREMENT OF SUBSTITUTE GOODS OR
  * SERVICES; LOSS OF USE, DATA, OR PROFITS; OR BUSINESS INTERRUPTION) HOWEVER
  * CAUSED AND ON ANY THEORY OF LIABILITY, WHETHER IN CONTRACT, STRICT LIABILITY,
  * OR TORT (INCLUDING NEGLIGENCE OR OTHERWISE) ARISING IN ANY WAY OUT OF THE USE
  * OF THIS SOFTWARE, EVEN IF ADVISED OF THE POSSIBILITY OF SUCH DAMAGE.
  *
  ******************************************************************************
  */
/* USER CODE END Header */

#include "main.h"

/* USER CODE BEGIN Includes */
#include "rcc.h"
#include "gpio.h"
#include "adc.h"
#include "uart.h"
#include <stdarg.h>
/* USER CODE END Includes */

void SystemClock_Config(void);
static void MX_GPIO_Init(void);

/* USER CODE BEGIN 0 */
int channelSeq[] = {18, 13, 5, -1};
char uartPrintBuffer[512];
int count = 0;
int voltage_chn13, voltage_chn5, temp_chn18;

void uartPrint(char *message, ...) {
	va_list args;
	int length, i;

	va_start(args, message);

	length = vsnprintf(uartPrintBuffer, 0, message, args);

	if(length > 511)
		length = 511;
	vsnprintf(uartPrintBuffer, length + 1, message, args);

	for(i = 0; i < length; i++) {
		while(!(USART_IS_TX_REG_EMPTY(usart5)));
			usart5->DR = uartPrintBuffer[i];
	}
}

void enableAdc(AdcReg *adc) {

	if(adc == adc1)
		ENABLE_ADC1_CLK_GATING();

	else if(adc == adc2)
		ENABLE_ADC2_CLK_GATING();

	else if(adc == adc3)
		ENABLE_ADC3_CLK_GATING();

	else
		return;
	RESET_ADC();

	UNRESET_ADC();
	//ADC_START_CONVERSION(adc);
}

void readInternalTemp(AdcReg *adc) {

	  //sprintf(uartPrintBuffer, "Temperature: %.2f\n\n", temperature);
}
/* USER CODE END 0 */

int main(void)
{
  /* USER CODE BEGIN 1 */
	ENABLE_USART5_CLK_GATING();
	ENABLE_GPIOA_CLK_GATING();
	ENABLE_GPIOC_CLK_GATING();
	RESET_GPIOA();
	RESET_USART5();
	RESET_GPIOC();
	UNRESET_GPIOA();
	UNRESET_GPIOC();
	UNRESET_USART5();
	enableAdc(adc1);

	adcChannelSamplingTime(adc1, 5, ADC_480_CYCLES);
	adcChannelSamplingTime(adc1, 13, ADC_480_CYCLES);
	ADC_SET_PRESCALER(ADC_PRESCALER_BY_2);
	adcChannelSamplingTime(adc1, 18, ADC_480_CYCLES);
	adcSetChannelSamplingSequence(adc1, channelSeq);
	adcConfigure(adc1, ADC_RESO_10_BIT | ADC_SCAN_MODE_ENABLE | ADC_RIGHT_ALIGNMENT | ADC_ON | ADC_EACH_CONV_EOC);
	gpioConfigurePin(gpioA, GpioPin5, GPIO_ANALOG | GPIO_PUSH_PULL | GPIO_VERY_HIGH_SPEED | GPIO_NO_PULL);
	gpioConfigurePin(gpioC, GpioPin3, GPIO_ANALOG | GPIO_PUSH_PULL | GPIO_VERY_HIGH_SPEED | GPIO_NO_PULL);
	gpioConfigurePin(gpioC, GpioPin12, GPIO_ALT_FUNC | GPIO_PUSH_PULL | GPIO_VERY_HIGH_SPEED | GPIO_NO_PULL);
	usartConfigure(usart5, USART_SAMPLING_16 | USART_RX_ENABLE | USART_TX_ENABLE | USART_PARITY_OFF | USART_WORDLENGTH_8 |  \
					  USART_STOP_BIT_1 | USART_ENABLE, 115200, 45000000);
	gpioConfigureAltFunc(gpioC, GpioPin12, GPIO_AF8);
	ADC_TEMP_SENSOR_ENABLE();
	//readInternalTemp(adc1);

  /* USER CODE END 1 */

  /* MCU Configuration--------------------------------------------------------*/

  /* Reset of all peripherals, Initializes the Flash interface and the Systick. */
  HAL_Init();

  /* Configure the system clock */
  SystemClock_Config();

  /* Initialize all configured peripherals */
  MX_GPIO_Init();
  /* USER CODE BEGIN 2 */
  ADC_CLEAR_ALL_FLAGS(adc1);
  /* USER CODE END 2 */

  /* Infinite loop */
  /* USER CODE BEGIN WHILE */
  while (1)
  {
	  do {
		  do {
			  ADC_CLEAR_ALL_FLAGS(adc1);
			  ADC_START_CONVERSION(adc1);
			  while(!(ADC_HAS_CONVERSION_ENDED(adc1)))
				  if(ADC_IS_ADC_OVERRUN(adc1))
					  goto overrunOccured;
			  temp_chn18 = adcReadValue(adc1);
			  while(!(ADC_HAS_CONVERSION_ENDED(adc1)))
				  if(ADC_IS_ADC_OVERRUN(adc1))
					  goto overrunOccured;
			  voltage_chn13 = adcReadValue(adc1);
			  while(!(ADC_HAS_CONVERSION_ENDED(adc1)))
				  if(ADC_IS_ADC_OVERRUN(adc1))
					  goto overrunOccured;
			  voltage_chn5 = adcReadValue(adc1);

			  uartPrint("%d\t%d\t%d : %.3f\t%.3f\t     %.3f\n", temp_chn18, voltage_chn13, voltage_chn5, (((temp_chn18 * 0.00293551) - 0.76) / 0.0025) + 25, 3.0*voltage_chn13/1023,  3.0*voltage_chn5/1023);
			  HAL_Delay(100);
		  } while(1);
		  overrunOccured:
		  ADC_CLEAR_STATUS(adc1, ADC_OVR | ADC_EOC);
  }while(1);

    /* USER CODE END WHILE */

  }
}

void SystemClock_Config(void)
{
  RCC_OscInitTypeDef RCC_OscInitStruct = {0};
  RCC_ClkInitTypeDef RCC_ClkInitStruct = {0};

  /**Configure the main internal regulator output voltage
  */
  __HAL_RCC_PWR_CLK_ENABLE();
  __HAL_PWR_VOLTAGESCALING_CONFIG(PWR_REGULATOR_VOLTAGE_SCALE1);
  /**Initializes the CPU, AHB and APB busses clocks
  */
  RCC_OscInitStruct.OscillatorType = RCC_OSCILLATORTYPE_HSE;
  RCC_OscInitStruct.HSEState = RCC_HSE_ON;
  RCC_OscInitStruct.PLL.PLLState = RCC_PLL_ON;
  RCC_OscInitStruct.PLL.PLLSource = RCC_PLLSOURCE_HSE;
  RCC_OscInitStruct.PLL.PLLM = 4;
  RCC_OscInitStruct.PLL.PLLN = 180;
  RCC_OscInitStruct.PLL.PLLP = RCC_PLLP_DIV2;
  RCC_OscInitStruct.PLL.PLLQ = 4;
  if (HAL_RCC_OscConfig(&RCC_OscInitStruct) != HAL_OK)
  {
    Error_Handler();
  }
  /**Activate the Over-Drive mode
  */
  if (HAL_PWREx_EnableOverDrive() != HAL_OK)
  {
    Error_Handler();
  }
  /**Initializes the CPU, AHB and APB busses clocks
  */
  RCC_ClkInitStruct.ClockType = RCC_CLOCKTYPE_HCLK|RCC_CLOCKTYPE_SYSCLK
                              |RCC_CLOCKTYPE_PCLK1|RCC_CLOCKTYPE_PCLK2;
  RCC_ClkInitStruct.SYSCLKSource = RCC_SYSCLKSOURCE_PLLCLK;
  RCC_ClkInitStruct.AHBCLKDivider = RCC_SYSCLK_DIV1;
  RCC_ClkInitStruct.APB1CLKDivider = RCC_HCLK_DIV4;
  RCC_ClkInitStruct.APB2CLKDivider = RCC_HCLK_DIV2;

  if (HAL_RCC_ClockConfig(&RCC_ClkInitStruct, FLASH_LATENCY_5) != HAL_OK)
  {
    Error_Handler();
  }
}

static void MX_GPIO_Init(void)
{

  /* GPIO Ports Clock Enable */
  __HAL_RCC_GPIOH_CLK_ENABLE();
  __HAL_RCC_GPIOA_CLK_ENABLE();

}

void Error_Handler(void)
{
}

/************************ (C) COPYRIGHT STMicroelectronics *****END OF FILE****/
